## package/lpn/lora-gateway/Config.in
```kconfig
config LORA_GW_INSTALL_TEST
    bool "Install test utilities"
    depends on PACKAGE_lora-gateway
    default n
    help
        Installs additional test utilities.
        - test_loragw_cal
        - test_loragw_gps
        - test_loragw_hal
        - test_loragw_reg
        - test_loragw_spi
        - util_pkt_logger
        - util_spi_stress
```

## package/lpn/packet-forwarder/Config.in
```kconfig
config PACKET_FW_INSTALL_TEST
    bool "Install additional utilities"
    depends on PACKAGE_packet-forwarder
    default n
    help
        Installs additional test utilities.
        - update_gwid.sh
        - util_ack
        - util_sink
        - util_tx_test
```
